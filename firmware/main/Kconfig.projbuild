## firmware/main/Kconfig.projbuild
```kconfig
menu "PrintBack"

config PRINTBACK_TRACKER_CAPACITY
    int "Tracker capacity (unique devices in window)"
    range 64 8192
    default 1024

config PRINTBACK_WINDOW_SECONDS
    int "Active-device window (seconds)"
    range 30 3600
    default 300

config PRINTBACK_HOP_INTERVAL_MS
    int "Channel-hop dwell time (ms)"
    range 100 5000
    default 400

config PRINTBACK_STATS_INTERVAL_SECONDS
    int "Periodic stats log interval (seconds)"
    range 5 600
    default 30

config PRINTBACK_RSSI_FLOOR
    int "RSSI floor (dBm, drop weaker frames)"
    range -100 0
    default -85

config PRINTBACK_JSON_OUTPUT
    bool "Emit one JSON line per observation"
    default y

menu "Pins (XIAO ESP32-C6)"

config PRINTBACK_PIN_BUTTON
    int "Tact switch GPIO"
    default 2
    help
        D2 on XIAO ESP32-C6. Other pin → GND. Internal pull-up is used.

config PRINTBACK_PIN_LED_R
    int "RGB LED, Red GPIO"
    default 21
    help
        D3 on XIAO ESP32-C6.

config PRINTBACK_PIN_LED_G
    int "RGB LED, Green GPIO"
    default 23
    help
        D5 on XIAO ESP32-C6.

config PRINTBACK_PIN_LED_B
    int "RGB LED, Blue GPIO"
    default 22
    help
        D4 on XIAO ESP32-C6.

config PRINTBACK_LED_COMMON_ANODE
    bool "RGB LED is common-anode"
    default n
    help
        Enable if the long leg of your RGB LED goes to 3V3 instead of GND.
        Inverts PWM duty so colour logic stays positive.

config PRINTBACK_PIN_SD_MOSI
    int "SD card SPI MOSI GPIO"
    default 18
    help
        D10 on XIAO ESP32-C6, hardware SPI2 MOSI.

config PRINTBACK_PIN_SD_MISO
    int "SD card SPI MISO GPIO"
    default 20
    help
        D9 on XIAO ESP32-C6, hardware SPI2 MISO.

config PRINTBACK_PIN_SD_SCK
    int "SD card SPI SCK GPIO"
    default 19
    help
        D8 on XIAO ESP32-C6, hardware SPI2 SCK.

config PRINTBACK_PIN_SD_CS
    int "SD card SPI CS GPIO"
    default 1
    help
        D1 on XIAO ESP32-C6. General-purpose GPIO, deliberately not
        GPIO16/17 (U0TXD/U0RXD): the generated sdkconfig isn't tracked in
        this repo, so we can't be sure the console isn't routed there on
        every build. GPIO1 has no default system role.

endmenu

menu "SD storage"

config PRINTBACK_SD_RETENTION_DAYS
    int "Raw log retention on SD (days)"
    range 1 365
    default 30
    help
        Hard limit on raw data retention (docs/compliance/README.md). Files
        older than this are purged on a rolling basis, see
        docs/ARCHITECTURE.md "SD layout".

config PRINTBACK_FALLBACK_UNIX_EPOCH
    int "Fallback wall-clock time at boot (unix seconds, UTC)"
    default 1783468800
    help
        The device has no RTC (docs/ARCHITECTURE.md "Wall-clock time").
        Until BLE time sync exists (Phase 4/5), this seeds
        sd_storage's wall clock at boot so raw log file names
        (YYYY-MM-DD.bin) are meaningful today. Bump this in menuconfig
        before flashing if you're testing weeks after this default was
        set. sd_storage_set_wallclock_unix_s() overrides it at runtime
        once BLE sync lands.

endmenu

menu "Whitelist capture"

config PRINTBACK_LONG_PRESS_MS
    int "Long-press duration (ms) to arm capture"
    range 500 10000
    default 3000

config PRINTBACK_ARMED_TIMEOUT_SECONDS
    int "How long ARMED stays active (seconds)"
    range 3 120
    default 15

config PRINTBACK_ARMED_RSSI_THRESHOLD
    int "Min RSSI to accept a capture (dBm)"
    range -90 0
    default -45
    help
        Captured fingerprint must be at least this strong. Default -45 dBm
        means the device must be within ~30 cm of the antenna.

config PRINTBACK_AUTO_WL_WINDOW_HOURS
    int "Auto-whitelist rolling window (hours)"
    range 2 24
    default 8
    help
        A fingerprint seen in enough distinct hours within this rolling
        window is treated as "sits here all shift, not a customer" and
        auto-whitelisted (docs/compliance/README.md "Auto-whitelist").

config PRINTBACK_AUTO_WL_MIN_DISTINCT_HOURS
    int "Auto-whitelist threshold (distinct hours in the window)"
    range 2 24
    default 6
    help
        How many distinct hours within the window a fingerprint must
        appear in before it is auto-whitelisted. Must be <= the window.

config PRINTBACK_AUTO_WL_MIN_OBSERVATIONS
    int "Auto-whitelist threshold (total observations)"
    range 0 65535
    default 30
    help
        In addition to the distinct-hours threshold, a fingerprint must be
        observed at least this many times total before it is
        auto-whitelisted (docs/compliance/README.md names 30). Stops a
        device merely glimpsed once in each of several hours from being
        excluded as if it were fixed infrastructure. 0 disables this gate.

config PRINTBACK_AUTO_WL_MAX_CANDIDATES
    int "Max fingerprints tracked for auto-whitelisting"
    range 8 256
    default 64
    help
        RAM cap: the accumulator tracks at most this many candidate
        fingerprints, evicting the least-recently-seen one when full
        (firmware/main/wl_auto.c). Keeps per-fingerprint hour-set state
        bounded regardless of foot traffic.

endmenu

menu "Pairing (BLE bonding)"

config PRINTBACK_PAIRING_WINDOW_SECONDS
    int "How long the pairing window stays open (seconds)"
    range 10 300
    default 60
    help
        A short click on the tact switch opens this window
        (docs/DECISIONS.md D5): only during this time will the device
        accept a BLE connection from a phone it hasn't bonded with
        before (firmware/main/ble_gatt.c). Outside the window, only
        already-bonded phones can connect at all.

endmenu

endmenu
```

## firmware/sdkconfig.defaults
```kconfig
CONFIG_IDF_TARGET="esp32c6"

# --- WiFi / sniffer plumbing ---------------------------------------------
CONFIG_ESP_WIFI_ENABLED=y
CONFIG_ESP_WIFI_STATIC_RX_BUFFER_NUM=16
CONFIG_ESP_WIFI_DYNAMIC_RX_BUFFER_NUM=64
CONFIG_ESP_WIFI_TX_BUFFER_TYPE=1
CONFIG_ESP_WIFI_DYNAMIC_TX_BUFFER_NUM=32
CONFIG_ESP_WIFI_AMPDU_RX_ENABLED=y
CONFIG_ESP_WIFI_AMPDU_TX_ENABLED=y

# --- PrintBack: BLE (Phase 4, NimBLE, ESP32-C6 has no BR/EDR radio, so ----
# none of the classic-ESP32 BTDM_CTRL_MODE_* options apply here) ----------
CONFIG_BT_ENABLED=y
CONFIG_BT_NIMBLE_ENABLED=y
CONFIG_BT_NIMBLE_HCI_EVT_BUF_SIZE=70

# Explicit even though this defaults to y automatically once WiFi+BT are
# both enabled (components/esp_coex/Kconfig): the docs used to reference
# the wrong flag name (CONFIG_SW_COEXIST_ENABLE, doesn't exist), verified
# against ESP-IDF 5.3.2 source in Phase 4, see docs/DECISIONS.md D4.
CONFIG_ESP_COEX_SW_COEXIST_ENABLE=y

# WiFi sniffer + FATFS + NimBLE together no longer fit the default 1MB
# "factory" app partition (measured overflow ~81KB on first Phase 4
# build); the 1.46MB single-app-large table has enough headroom.
CONFIG_PARTITION_TABLE_SINGLE_APP_LARGE=y

# --- System --------------------------------------------------------------
CONFIG_LOG_DEFAULT_LEVEL_INFO=y
CONFIG_LOG_MAXIMUM_LEVEL_DEBUG=y
CONFIG_FREERTOS_HZ=1000
CONFIG_ESP_MAIN_TASK_STACK_SIZE=8192
CONFIG_MBEDTLS_HARDWARE_SHA=y

# --- Task Watchdog Timer -------------------------------------------------
# Hardware-level recovery from firmware hangs. Resets the chip if any task
# (including the idle task, which catches CPU starvation / blocked main
# loop) does not run for >10s. Paired with the host-side serial watchdog
# this gives end-to-end auto recovery: ESP resets within 10s, host re-opens
# the port within the next ~20s, no manual unplug/replug needed.
CONFIG_ESP_TASK_WDT_INIT=y
CONFIG_ESP_TASK_WDT_TIMEOUT_S=10
CONFIG_ESP_TASK_WDT_PANIC=y
CONFIG_ESP_TASK_WDT_CHECK_IDLE_TASK_CPU0=y

# --- Interrupt Watchdog --------------------------------------------------
# Catches ISR-level hangs that the task watchdog can't reach (e.g., critical
# section held too long, runaway interrupt handler). 300ms is the IDF default
# and is conservative enough to never false-trigger under normal load.
CONFIG_ESP_INT_WDT=y
CONFIG_ESP_INT_WDT_TIMEOUT_MS=300

# --- Brownout Detector ---------------------------------------------------
# Resets the chip cleanly when the 3.3V rail dips below the threshold instead
# of letting undefined behaviour propagate. Important for deployments running
# off cheap wall-warts where voltage sags happen.
CONFIG_ESP_BROWNOUT_DET=y
CONFIG_ESP_BROWNOUT_DET_LVL_SEL_7=y

# --- PrintBack: pinout (XIAO ESP32-C6) -----------------------------------
# D2=GPIO2 (tact), D3=GPIO21 (B), D4=GPIO22 (G), D5=GPIO23 (R)
CONFIG_PRINTBACK_PIN_BUTTON=2
CONFIG_PRINTBACK_PIN_LED_R=23
CONFIG_PRINTBACK_PIN_LED_G=22
CONFIG_PRINTBACK_PIN_LED_B=21

# Flip to =y if your RGB LED's long leg goes to 3V3 (common-anode).
CONFIG_PRINTBACK_LED_COMMON_ANODE=n

# --- PrintBack: SD card (Phase 2, SPI, XIAO ESP32-C6 hardware SPI2 pins) -
# MOSI=D10/GPIO18, MISO=D9/GPIO20, SCK=D8/GPIO19, CS=D1/GPIO1 (general
# purpose, avoids GPIO16/17 console ambiguity, see Kconfig.projbuild).
CONFIG_PRINTBACK_PIN_SD_MOSI=18
CONFIG_PRINTBACK_PIN_SD_MISO=20
CONFIG_PRINTBACK_PIN_SD_SCK=19
CONFIG_PRINTBACK_PIN_SD_CS=1
CONFIG_PRINTBACK_SD_RETENTION_DAYS=30

# Wall-clock fallback until BLE time sync exists (Phase 4/5). Bump before
# flashing if testing long after this default was set.
CONFIG_PRINTBACK_FALLBACK_UNIX_EPOCH=1783468800

# --- PrintBack: tracker --------------------------------------------------
CONFIG_PRINTBACK_TRACKER_CAPACITY=1024
CONFIG_PRINTBACK_WINDOW_SECONDS=300
CONFIG_PRINTBACK_HOP_INTERVAL_MS=400
CONFIG_PRINTBACK_STATS_INTERVAL_SECONDS=30
CONFIG_PRINTBACK_RSSI_FLOOR=-85
CONFIG_PRINTBACK_JSON_OUTPUT=y

# --- PrintBack: whitelist capture ----------------------------------------
CONFIG_PRINTBACK_LONG_PRESS_MS=3000
CONFIG_PRINTBACK_ARMED_TIMEOUT_SECONDS=30
CONFIG_PRINTBACK_ARMED_RSSI_THRESHOLD=-45
```

## main/Kconfig.projbuild
```kconfig
menu "PrintBack"

config PRINTBACK_TRACKER_CAPACITY
    int "Tracker capacity (unique devices in window)"
    range 64 8192
    default 1024

config PRINTBACK_WINDOW_SECONDS
    int "Active-device window (seconds)"
    range 30 3600
    default 300
    help
        How long a fingerprint stays counted as "present" after the
        last probe before the sweeper evicts it.

config PRINTBACK_HOP_INTERVAL_MS
    int "Channel-hop dwell time (ms)"
    range 100 5000
    default 400

config PRINTBACK_STATS_INTERVAL_SECONDS
    int "Periodic stats log interval (seconds)"
    range 5 600
    default 30

config PRINTBACK_RSSI_FLOOR
    int "RSSI floor (dBm, drop weaker frames)"
    range -100 0
    default -85

config PRINTBACK_JSON_OUTPUT
    bool "Emit one JSON line per observation"
    default y

endmenu
```

## sdkconfig.defaults
```kconfig
CONFIG_IDF_TARGET="esp32c6"

# --- WiFi / sniffer plumbing ---------------------------------------------
CONFIG_ESP_WIFI_ENABLED=y
CONFIG_ESP_WIFI_STATIC_RX_BUFFER_NUM=16
CONFIG_ESP_WIFI_DYNAMIC_RX_BUFFER_NUM=64
CONFIG_ESP_WIFI_TX_BUFFER_TYPE=1
CONFIG_ESP_WIFI_DYNAMIC_TX_BUFFER_NUM=32
CONFIG_ESP_WIFI_AMPDU_RX_ENABLED=y
CONFIG_ESP_WIFI_AMPDU_TX_ENABLED=y

# --- System --------------------------------------------------------------
CONFIG_LOG_DEFAULT_LEVEL_INFO=y
CONFIG_LOG_MAXIMUM_LEVEL_DEBUG=y
CONFIG_FREERTOS_HZ=1000
CONFIG_ESP_MAIN_TASK_STACK_SIZE=8192
CONFIG_MBEDTLS_HARDWARE_SHA=y

# --- PrintBack: pinout (XIAO ESP32-C6) -----------------------------------
# D2=GPIO2 (tact), D3=GPIO21 (B), D4=GPIO22 (G), D5=GPIO23 (R)
CONFIG_PRINTBACK_PIN_BUTTON=2
CONFIG_PRINTBACK_PIN_LED_R=23
CONFIG_PRINTBACK_PIN_LED_G=22
CONFIG_PRINTBACK_PIN_LED_B=21

# Flip to =y if your RGB LED's long leg goes to 3V3 (common-anode).
CONFIG_PRINTBACK_LED_COMMON_ANODE=n

# --- PrintBack: tracker --------------------------------------------------
CONFIG_PRINTBACK_TRACKER_CAPACITY=1024
CONFIG_PRINTBACK_WINDOW_SECONDS=300
CONFIG_PRINTBACK_HOP_INTERVAL_MS=400
CONFIG_PRINTBACK_STATS_INTERVAL_SECONDS=30
CONFIG_PRINTBACK_RSSI_FLOOR=-85
CONFIG_PRINTBACK_JSON_OUTPUT=y

# --- PrintBack: whitelist capture ----------------------------------------
CONFIG_PRINTBACK_LONG_PRESS_MS=3000
CONFIG_PRINTBACK_ARMED_TIMEOUT_SECONDS=15
CONFIG_PRINTBACK_ARMED_RSSI_THRESHOLD=-45
```
